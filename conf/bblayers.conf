## conf/bblayers.conf
```bitbake
# POKY_BBLAYERS_CONF_VERSION is increased each time build/conf/bblayers.conf
# changes incompatibly
POKY_BBLAYERS_CONF_VERSION = "2"

BBPATH = "${TOPDIR}"
BBFILES ?= ""

BBLAYERS ?= " \
  ${TOPDIR}/../poky/meta \
  ${TOPDIR}/../poky/meta-poky \
  ${TOPDIR}/../poky/meta-yocto-bsp \
  ${TOPDIR}/../layers/meta-rk3399 \
  ${TOPDIR}/../layers/meta-linaro/meta-linaro-toolchain \
  ${TOPDIR}/../layers/meta-linaro/meta-optee \
  ${TOPDIR}/../layers/meta-openembedded/meta-oe \
  ${TOPDIR}/../layers/meta-openembedded/meta-networking \
  ${TOPDIR}/../layers/meta-openembedded/meta-python \
  "
```

## conf/layer.conf
```bitbake
# We have a conf and classes directory, add to BBPATH
BBPATH .= ":${LAYERDIR}"

# We have recipes-* directories, add to BBFILES
BBFILES += "${LAYERDIR}/recipes-*/*/*.bb ${LAYERDIR}/recipes-*/*/*.bbappend"

BBFILE_COLLECTIONS += "rk3399"
BBFILE_PATTERN_rk3399 = "^${LAYERDIR}/"
BBFILE_PRIORITY_rk3399 = "1"

# This should only be incremented on significant changes that will
# cause compatibility issues with other layers
LAYERVERSION_rk3399 = "1"

LAYERDEPENDS_rk3399 = "core"
LICENSE_PATH += "${LAYERDIR}/licenses"

# The .bbappend and .bb files are included if the respective layer
# collection is available.
BBFILES += "${@' '.join('${LAYERDIR}/dynamic-layers/%s/recipes*/*/*.bbappend' % layer \
               for layer in BBFILE_COLLECTIONS.split())}"
BBFILES += "${@' '.join('${LAYERDIR}/dynamic-layers/%s/recipes*/*/*.bb' % layer \
               for layer in BBFILE_COLLECTIONS.split())}"
```

## conf/machine/ibox3399.conf
```bitbake
SOC_FAMILY = "rk3399"

MACHINE ??= "ibox3399"

require conf/machine/include/arm/arch-armv8.inc
require conf/machine/include/soc-family.inc

KERNEL_IMAGETYPE = "Image"
IMAGE_FSTYPES_append = " ext2"

# Add variable to Build Configuration in build log
BUILDCFG_VARS_append = " SOC_FAMILY"

PREFERRED_VERSION_xen = "4.10.0+git%"
PREFERRED_PROVIDER_virtual/kernel = "linux-9tripod"

KERNEL_DEVICETREE = " \
    rockchip/x3399-dom0-development-board.dtb \
"
```
